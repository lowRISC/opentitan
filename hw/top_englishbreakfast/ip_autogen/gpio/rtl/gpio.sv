// Copyright lowRISC contributors (OpenTitan project).
// Licensed under the Apache License, Version 2.0, see LICENSE for details.
// SPDX-License-Identifier: Apache-2.0
//
// General Purpose Input/Output module

`include "prim_assert.sv"

module gpio
  import gpio_pkg::*;
  import gpio_reg_pkg::*;
#(
  parameter logic [NumAlerts-1:0]           AlertAsyncOn              = {NumAlerts{1'b1}},
  // Number of cycles a differential skew is tolerated on the alert signal
  parameter int unsigned                    AlertSkewCycles           = 1,
  parameter bit                             GpioAsHwStrapsEn          = 1,
  // This parameter instantiates 2-stage synchronizers on all GPIO inputs.
  parameter bit                             GpioAsyncOn               = 1,
  parameter bit                             EnableRacl                = 1'b0,
  parameter bit                             RaclErrorRsp              = 1'b1,
  parameter top_racl_pkg::racl_policy_sel_t RaclPolicySelVec[NumRegs] = '{NumRegs{0}}
) (
  input clk_i,
  input rst_ni,

  // Strap sampling trigger and broadcast output
  input strap_en_i,
  output gpio_straps_t sampled_straps_o,

  // Bus interface
  input  tlul_pkg::tl_h2d_t tl_i,
  output tlul_pkg::tl_d2h_t tl_o,

  // Interrupts
  output logic [NumIOs-1:0] intr_gpio_o,

  // Alerts
  input  prim_alert_pkg::alert_rx_t [NumAlerts-1:0] alert_rx_i,
  output prim_alert_pkg::alert_tx_t [NumAlerts-1:0] alert_tx_o,

  // RACL interface
  input  top_racl_pkg::racl_policy_vec_t  racl_policies_i,
  output top_racl_pkg::racl_error_log_t   racl_error_o,

  // GPIOs
  input        [NumIOs-1:0] cio_gpio_i,
  output logic [NumIOs-1:0] cio_gpio_o,
  output logic [NumIOs-1:0] cio_gpio_en_o
);
  gpio_reg2hw_t reg2hw;
  gpio_hw2reg_t hw2reg;

  logic [NumIOs-1:0] cio_gpio_q;
  logic [NumIOs-1:0] cio_gpio_en_q;
  logic [NumIOs-1:0] intr_ctrl_en_rising_q, intr_ctrl_en_falling_q;
  logic [NumIOs-1:0] intr_ctrl_en_lvlhigh_q, intr_ctrl_en_lvllow_q;
  logic [NumIOs-1:0] ctrl_en_input_filter_q;

  // Per-pin register views, gathered into one vector per field
  logic [NumIOs-1:0] per_pin_out_qe, per_pin_out_q;
  logic [NumIOs-1:0] per_pin_cfg_qe, per_pin_oe_q;
  logic [NumIOs-1:0] per_pin_rising_q, per_pin_falling_q, per_pin_lvlhigh_q, per_pin_lvllow_q;
  logic [NumIOs-1:0] per_pin_filter_q;

  // possibly filter the input based upon register configuration
  logic [NumIOs-1:0] data_in_d;
  localparam int unsigned CntWidth = 4;
  for (genvar i = 0 ; i < NumIOs ; i++) begin : gen_filter
    prim_filter_ctr #(
      .AsyncOn(GpioAsyncOn),
      .CntWidth(CntWidth)
    ) u_filter (
      .clk_i,
      .rst_ni,
      .enable_i(ctrl_en_input_filter_q[i]),
      .filter_i(cio_gpio_i[i]),
      .thresh_i({CntWidth{1'b1}}),
      .filter_o(data_in_d[i])
    );
  end

  // Detect rising and falling edges.
  logic [NumIOs-1:0] data_in_q, event_rise, event_fall;
  always_ff @(posedge clk_i) begin
    data_in_q <= data_in_d;
  end
  assign event_rise = data_in_d & ~data_in_q;
  assign event_fall = ~data_in_d & data_in_q;

  if (GpioAsHwStrapsEn) begin : gen_strap_sample
    // sample at gpio inputs at strap_en_i signal pulse.
    logic strap_en;

    // The strap_en_i is a single cycle pulse generated by the pwrmgr
    // Both sender (pwrmgr) and receiver (gpio controller) are in the same clock domain (io_div4)
    // A cdc synchronizer is not required
    //
    assign strap_en = strap_en_i;

    // we guarantee here by design that this will always be done exactly once per reset cycle.
    logic sample_trigger;
    assign sample_trigger                    = strap_en && !reg2hw.hw_straps_data_in_valid.q;
    assign hw2reg.hw_straps_data_in_valid.de = sample_trigger;
    assign hw2reg.hw_straps_data_in_valid.d  = 1'b1;
    assign hw2reg.hw_straps_data_in.de       = sample_trigger;
    assign hw2reg.hw_straps_data_in.d        = data_in_d;
    assign sampled_straps_o.data             = reg2hw.hw_straps_data_in.q;
    assign sampled_straps_o.valid            = reg2hw.hw_straps_data_in_valid.q;
  end else begin : gen_no_strap_sample
    assign hw2reg.hw_straps_data_in_valid.de = 1'b0;
    assign hw2reg.hw_straps_data_in_valid.d  = 1'b0;
    assign hw2reg.hw_straps_data_in.de       = 1'b0;
    assign hw2reg.hw_straps_data_in.d        = '0;
    assign sampled_straps_o.data             = '0;
    assign sampled_straps_o.valid            = 1'b0;

    logic unused_signals;
    assign unused_signals = ^{strap_en_i,
                              reg2hw.hw_straps_data_in.q,
                              reg2hw.hw_straps_data_in_valid.q};
  end

  // GPIO_IN
  assign hw2reg.data_in.de = 1'b1;
  assign hw2reg.data_in.d  = data_in_d;

  // Per-pin views
  for (genvar i = 0; i < NumIOs; i++) begin : gen_per_pin
    assign per_pin_out_qe[i]    = reg2hw.per_pin_io[i].data_out.qe;
    assign per_pin_out_q[i]     = reg2hw.per_pin_io[i].data_out.q;
    // All fields of a register are written together
    assign per_pin_cfg_qe[i]    = reg2hw.per_pin_cfg[i].oe.qe;
    assign per_pin_oe_q[i]      = reg2hw.per_pin_cfg[i].oe.q;
    assign per_pin_rising_q[i]  = reg2hw.per_pin_cfg[i].intr_ctrl_en_rising.q;
    assign per_pin_falling_q[i] = reg2hw.per_pin_cfg[i].intr_ctrl_en_falling.q;
    assign per_pin_lvlhigh_q[i] = reg2hw.per_pin_cfg[i].intr_ctrl_en_lvlhigh.q;
    assign per_pin_lvllow_q[i]  = reg2hw.per_pin_cfg[i].intr_ctrl_en_lvllow.q;
    assign per_pin_filter_q[i]  = reg2hw.per_pin_cfg[i].ctrl_en_input_filter.q;

    assign hw2reg.per_pin_io[i].data_out.d              = cio_gpio_q[i];
    assign hw2reg.per_pin_io[i].data_in.d               = data_in_d[i];
    assign hw2reg.per_pin_cfg[i].oe.d                   = cio_gpio_en_q[i];
    assign hw2reg.per_pin_cfg[i].intr_ctrl_en_rising.d  = intr_ctrl_en_rising_q[i];
    assign hw2reg.per_pin_cfg[i].intr_ctrl_en_falling.d = intr_ctrl_en_falling_q[i];
    assign hw2reg.per_pin_cfg[i].intr_ctrl_en_lvlhigh.d = intr_ctrl_en_lvlhigh_q[i];
    assign hw2reg.per_pin_cfg[i].intr_ctrl_en_lvllow.d  = intr_ctrl_en_lvllow_q[i];
    assign hw2reg.per_pin_cfg[i].ctrl_en_input_filter.d = ctrl_en_input_filter_q[i];

    logic unused_per_pin_cfg_qe;
    assign unused_per_pin_cfg_qe = ^{reg2hw.per_pin_cfg[i].intr_ctrl_en_rising.qe,
                                     reg2hw.per_pin_cfg[i].intr_ctrl_en_falling.qe,
                                     reg2hw.per_pin_cfg[i].intr_ctrl_en_lvlhigh.qe,
                                     reg2hw.per_pin_cfg[i].intr_ctrl_en_lvllow.qe,
                                     reg2hw.per_pin_cfg[i].ctrl_en_input_filter.qe};
  end

  // GPIO_OUT
  assign cio_gpio_o                     = cio_gpio_q;
  assign cio_gpio_en_o                  = cio_gpio_en_q;

  assign hw2reg.direct_out.d            = cio_gpio_q;
  assign hw2reg.masked_out_upper.data.d = cio_gpio_q[NumIOs-1:16];
  assign hw2reg.masked_out_upper.mask.d = 16'h 0;
  assign hw2reg.masked_out_lower.data.d = cio_gpio_q[15:0];
  assign hw2reg.masked_out_lower.mask.d = 16'h 0;

  always_ff @(posedge clk_i or negedge rst_ni) begin
    if (!rst_ni) begin
      cio_gpio_q  <= '0;
    end else if (reg2hw.direct_out.qe) begin
      cio_gpio_q <= reg2hw.direct_out.q;
    end else if (reg2hw.masked_out_upper.data.qe) begin
      cio_gpio_q[NumIOs-1:16] <=
        ( reg2hw.masked_out_upper.mask.q & reg2hw.masked_out_upper.data.q) |
        (~reg2hw.masked_out_upper.mask.q & cio_gpio_q[NumIOs-1:16]);
    end else if (reg2hw.masked_out_lower.data.qe) begin
      cio_gpio_q[15:0] <=
        ( reg2hw.masked_out_lower.mask.q & reg2hw.masked_out_lower.data.q) |
        (~reg2hw.masked_out_lower.mask.q & cio_gpio_q[15:0]);
    end else if (|per_pin_out_qe) begin
      cio_gpio_q <= (per_pin_out_qe & per_pin_out_q) | (~per_pin_out_qe & cio_gpio_q);
    end
  end

  // GPIO OE
  assign hw2reg.direct_oe.d = cio_gpio_en_q;
  assign hw2reg.masked_oe_upper.data.d = cio_gpio_en_q[NumIOs-1:16];
  assign hw2reg.masked_oe_upper.mask.d = 16'h 0;
  assign hw2reg.masked_oe_lower.data.d = cio_gpio_en_q[15:0];
  assign hw2reg.masked_oe_lower.mask.d = 16'h 0;

  always_ff @(posedge clk_i or negedge rst_ni) begin
    if (!rst_ni) begin
      cio_gpio_en_q  <= '0;
    end else if (reg2hw.direct_oe.qe) begin
      cio_gpio_en_q <= reg2hw.direct_oe.q;
    end else if (reg2hw.masked_oe_upper.data.qe) begin
      cio_gpio_en_q[NumIOs-1:16] <=
        ( reg2hw.masked_oe_upper.mask.q & reg2hw.masked_oe_upper.data.q) |
        (~reg2hw.masked_oe_upper.mask.q & cio_gpio_en_q[NumIOs-1:16]);
    end else if (reg2hw.masked_oe_lower.data.qe) begin
      cio_gpio_en_q[15:0] <=
        ( reg2hw.masked_oe_lower.mask.q & reg2hw.masked_oe_lower.data.q) |
        (~reg2hw.masked_oe_lower.mask.q & cio_gpio_en_q[15:0]);
    end else if (|per_pin_cfg_qe) begin
      cio_gpio_en_q <= (per_pin_cfg_qe & per_pin_oe_q) | (~per_pin_cfg_qe & cio_gpio_en_q);
    end
  end

  // Interrupt control and input filter
  assign hw2reg.intr_ctrl_en_rising.d  = intr_ctrl_en_rising_q;
  assign hw2reg.intr_ctrl_en_falling.d = intr_ctrl_en_falling_q;
  assign hw2reg.intr_ctrl_en_lvlhigh.d = intr_ctrl_en_lvlhigh_q;
  assign hw2reg.intr_ctrl_en_lvllow.d  = intr_ctrl_en_lvllow_q;
  assign hw2reg.ctrl_en_input_filter.d = ctrl_en_input_filter_q;

  always_ff @(posedge clk_i or negedge rst_ni) begin
    if (!rst_ni) begin
      intr_ctrl_en_rising_q  <= '0;
      intr_ctrl_en_falling_q <= '0;
      intr_ctrl_en_lvlhigh_q <= '0;
      intr_ctrl_en_lvllow_q  <= '0;
      ctrl_en_input_filter_q <= '0;
    end else if (|per_pin_cfg_qe) begin
      intr_ctrl_en_rising_q  <= (per_pin_cfg_qe & per_pin_rising_q) |
                                (~per_pin_cfg_qe & intr_ctrl_en_rising_q);
      intr_ctrl_en_falling_q <= (per_pin_cfg_qe & per_pin_falling_q) |
                                (~per_pin_cfg_qe & intr_ctrl_en_falling_q);
      intr_ctrl_en_lvlhigh_q <= (per_pin_cfg_qe & per_pin_lvlhigh_q) |
                                (~per_pin_cfg_qe & intr_ctrl_en_lvlhigh_q);
      intr_ctrl_en_lvllow_q  <= (per_pin_cfg_qe & per_pin_lvllow_q) |
                                (~per_pin_cfg_qe & intr_ctrl_en_lvllow_q);
      ctrl_en_input_filter_q <= (per_pin_cfg_qe & per_pin_filter_q) |
                                (~per_pin_cfg_qe & ctrl_en_input_filter_q);
    end else begin
      if (reg2hw.intr_ctrl_en_rising.qe) begin
        intr_ctrl_en_rising_q <= reg2hw.intr_ctrl_en_rising.q;
      end
      if (reg2hw.intr_ctrl_en_falling.qe) begin
        intr_ctrl_en_falling_q <= reg2hw.intr_ctrl_en_falling.q;
      end
      if (reg2hw.intr_ctrl_en_lvlhigh.qe) begin
        intr_ctrl_en_lvlhigh_q <= reg2hw.intr_ctrl_en_lvlhigh.q;
      end
      if (reg2hw.intr_ctrl_en_lvllow.qe) begin
        intr_ctrl_en_lvllow_q <= reg2hw.intr_ctrl_en_lvllow.q;
      end
      if (reg2hw.ctrl_en_input_filter.qe) begin
        ctrl_en_input_filter_q <= reg2hw.ctrl_en_input_filter.q;
      end
    end
  end

  logic [NumIOs-1:0] event_intr_rise, event_intr_fall, event_intr_actlow, event_intr_acthigh;
  logic [NumIOs-1:0] event_intr_combined;

  // instantiate interrupt hardware primitive
  prim_intr_hw #(.Width(NumIOs)) intr_hw (
    .clk_i,
    .rst_ni,
    .event_intr_i           (event_intr_combined),
    .reg2hw_intr_enable_q_i (reg2hw.intr_enable.q),
    .reg2hw_intr_test_q_i   (reg2hw.intr_test.q),
    .reg2hw_intr_test_qe_i  (reg2hw.intr_test.qe),
    .reg2hw_intr_state_q_i  (reg2hw.intr_state.q),
    .hw2reg_intr_state_de_o (hw2reg.intr_state.de),
    .hw2reg_intr_state_d_o  (hw2reg.intr_state.d),
    .intr_o                 (intr_gpio_o)
  );

  // detect four possible individual interrupts
  assign event_intr_rise    = event_rise & intr_ctrl_en_rising_q;
  assign event_intr_fall    = event_fall & intr_ctrl_en_falling_q;
  assign event_intr_acthigh =  data_in_d & intr_ctrl_en_lvlhigh_q;
  assign event_intr_actlow  = ~data_in_d & intr_ctrl_en_lvllow_q;

  assign event_intr_combined = event_intr_rise   |
                               event_intr_fall   |
                               event_intr_actlow |
                               event_intr_acthigh;

  // Alerts
  logic [NumAlerts-1:0] alert_test, alerts;
  assign alert_test = {
    reg2hw.alert_test.q &
    reg2hw.alert_test.qe
  };

  for (genvar i = 0; i < NumAlerts; i++) begin : gen_alert_tx
    prim_alert_sender #(
      .AsyncOn(AlertAsyncOn[i]),
      .SkewCycles(AlertSkewCycles),
      .IsFatal(1'b1)
    ) u_prim_alert_sender (
      .clk_i,
      .rst_ni,
      .alert_test_i  ( alert_test[i] ),
      .alert_req_i   ( alerts[0]     ),
      .alert_ack_o   (               ),
      .alert_state_o (               ),
      .alert_rx_i    ( alert_rx_i[i] ),
      .alert_tx_o    ( alert_tx_o[i] )
    );
  end

  // Register module
  gpio_reg_top #(
    .EnableRacl(EnableRacl),
    .RaclErrorRsp(RaclErrorRsp),
    .RaclPolicySelVec(RaclPolicySelVec)
  ) u_reg (
    .clk_i,
    .rst_ni,

    .tl_i,
    .tl_o,

    .reg2hw,
    .hw2reg,

    .racl_policies_i,
    .racl_error_o,

    // SEC_CM: BUS.INTEGRITY
    .intg_err_o (alerts[0])
  );

  // Assert Known: Outputs
  `ASSERT_KNOWN(IntrGpioKnown, intr_gpio_o)
  `ASSERT_KNOWN(CioGpioEnOKnown, cio_gpio_en_o)
  `ASSERT_KNOWN(CioGpioOKnown, cio_gpio_o)
  `ASSERT_KNOWN(AlertsKnown_A, alert_tx_o)
  `ASSERT_KNOWN(RaclErrorValidKnown_A, racl_error_o.valid)

  // Alert assertions for reg_we onehot check
  `ASSERT_PRIM_REG_WE_ONEHOT_ERROR_TRIGGER_ALERT(RegWeOnehotCheck_A, u_reg, alert_tx_o[0])

endmodule
