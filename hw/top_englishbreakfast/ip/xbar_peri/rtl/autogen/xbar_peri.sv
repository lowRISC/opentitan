// Copyright lowRISC contributors (OpenTitan project).
// Licensed under the Apache License, Version 2.0, see LICENSE for details.
// SPDX-License-Identifier: Apache-2.0
//
// xbar_peri module generated by `tlgen.py` tool
// all reset signals should be generated from one reset signal to not make any deadlock
//
// Interconnect
// main
//   -> s1n_13
//     -> uart0
//     -> uart1
//     -> gpio
//     -> spi_device
//     -> asf_14
//       -> spi_host0
//     -> rv_timer
//     -> asf_15
//       -> usbdev
//     -> pwrmgr_aon
//     -> rstmgr_aon
//     -> clkmgr_aon
//     -> pinmux_aon
//     -> ast

module xbar_peri (
  input clk_peri_i,
  input clk_spi_host0_i,
  input clk_usb_i,
  input rst_peri_ni,
  input rst_spi_host0_ni,
  input rst_usb_ni,

  // Host interfaces
  input  tlul_pkg::tl_h2d_t tl_main_i,
  output tlul_pkg::tl_d2h_t tl_main_o,

  // Device interfaces
  output tlul_pkg::tl_h2d_t tl_uart0_o,
  input  tlul_pkg::tl_d2h_t tl_uart0_i,
  output tlul_pkg::tl_h2d_t tl_uart1_o,
  input  tlul_pkg::tl_d2h_t tl_uart1_i,
  output tlul_pkg::tl_h2d_t tl_gpio_o,
  input  tlul_pkg::tl_d2h_t tl_gpio_i,
  output tlul_pkg::tl_h2d_t tl_spi_device_o,
  input  tlul_pkg::tl_d2h_t tl_spi_device_i,
  output tlul_pkg::tl_h2d_t tl_spi_host0_o,
  input  tlul_pkg::tl_d2h_t tl_spi_host0_i,
  output tlul_pkg::tl_h2d_t tl_rv_timer_o,
  input  tlul_pkg::tl_d2h_t tl_rv_timer_i,
  output tlul_pkg::tl_h2d_t tl_usbdev_o,
  input  tlul_pkg::tl_d2h_t tl_usbdev_i,
  output tlul_pkg::tl_h2d_t tl_pwrmgr_aon_o,
  input  tlul_pkg::tl_d2h_t tl_pwrmgr_aon_i,
  output tlul_pkg::tl_h2d_t tl_rstmgr_aon_o,
  input  tlul_pkg::tl_d2h_t tl_rstmgr_aon_i,
  output tlul_pkg::tl_h2d_t tl_clkmgr_aon_o,
  input  tlul_pkg::tl_d2h_t tl_clkmgr_aon_i,
  output tlul_pkg::tl_h2d_t tl_pinmux_aon_o,
  input  tlul_pkg::tl_d2h_t tl_pinmux_aon_i,
  output tlul_pkg::tl_h2d_t tl_ast_o,
  input  tlul_pkg::tl_d2h_t tl_ast_i,

  input prim_mubi_pkg::mubi4_t scanmode_i
);

  import tlul_pkg::*;
  import tl_peri_pkg::*;

  // scanmode_i is currently not used, but provisioned for future use
  // this assignment prevents lint warnings
  logic unused_scanmode;
  assign unused_scanmode = ^scanmode_i;

  tl_h2d_t tl_s1n_13_us_h2d ;
  tl_d2h_t tl_s1n_13_us_d2h ;


  tl_h2d_t tl_s1n_13_ds_h2d [12];
  tl_d2h_t tl_s1n_13_ds_d2h [12];

  // Create steering signal
  logic [3:0] dev_sel_s1n_13;

  tl_h2d_t tl_asf_14_us_h2d ;
  tl_d2h_t tl_asf_14_us_d2h ;
  tl_h2d_t tl_asf_14_ds_h2d ;
  tl_d2h_t tl_asf_14_ds_d2h ;

  tl_h2d_t tl_asf_15_us_h2d ;
  tl_d2h_t tl_asf_15_us_d2h ;
  tl_h2d_t tl_asf_15_ds_h2d ;
  tl_d2h_t tl_asf_15_ds_d2h ;



  assign tl_uart0_o = tl_s1n_13_ds_h2d[0];
  assign tl_s1n_13_ds_d2h[0] = tl_uart0_i;

  assign tl_uart1_o = tl_s1n_13_ds_h2d[1];
  assign tl_s1n_13_ds_d2h[1] = tl_uart1_i;

  assign tl_gpio_o = tl_s1n_13_ds_h2d[2];
  assign tl_s1n_13_ds_d2h[2] = tl_gpio_i;

  assign tl_spi_device_o = tl_s1n_13_ds_h2d[3];
  assign tl_s1n_13_ds_d2h[3] = tl_spi_device_i;

  assign tl_asf_14_us_h2d = tl_s1n_13_ds_h2d[4];
  assign tl_s1n_13_ds_d2h[4] = tl_asf_14_us_d2h;

  assign tl_rv_timer_o = tl_s1n_13_ds_h2d[5];
  assign tl_s1n_13_ds_d2h[5] = tl_rv_timer_i;

  assign tl_asf_15_us_h2d = tl_s1n_13_ds_h2d[6];
  assign tl_s1n_13_ds_d2h[6] = tl_asf_15_us_d2h;

  assign tl_pwrmgr_aon_o = tl_s1n_13_ds_h2d[7];
  assign tl_s1n_13_ds_d2h[7] = tl_pwrmgr_aon_i;

  assign tl_rstmgr_aon_o = tl_s1n_13_ds_h2d[8];
  assign tl_s1n_13_ds_d2h[8] = tl_rstmgr_aon_i;

  assign tl_clkmgr_aon_o = tl_s1n_13_ds_h2d[9];
  assign tl_s1n_13_ds_d2h[9] = tl_clkmgr_aon_i;

  assign tl_pinmux_aon_o = tl_s1n_13_ds_h2d[10];
  assign tl_s1n_13_ds_d2h[10] = tl_pinmux_aon_i;

  assign tl_ast_o = tl_s1n_13_ds_h2d[11];
  assign tl_s1n_13_ds_d2h[11] = tl_ast_i;

  assign tl_s1n_13_us_h2d = tl_main_i;
  assign tl_main_o = tl_s1n_13_us_d2h;

  assign tl_spi_host0_o = tl_asf_14_ds_h2d;
  assign tl_asf_14_ds_d2h = tl_spi_host0_i;

  assign tl_usbdev_o = tl_asf_15_ds_h2d;
  assign tl_asf_15_ds_d2h = tl_usbdev_i;

  always_comb begin
    // default steering to generate error response if address is not within the range
    dev_sel_s1n_13 = 4'd12;
    if ((tl_s1n_13_us_h2d.a_address &
         ~(ADDR_MASK_UART0)) == ADDR_SPACE_UART0) begin
      dev_sel_s1n_13 = 4'd0;

    end else if ((tl_s1n_13_us_h2d.a_address &
                  ~(ADDR_MASK_UART1)) == ADDR_SPACE_UART1) begin
      dev_sel_s1n_13 = 4'd1;

    end else if ((tl_s1n_13_us_h2d.a_address &
                  ~(ADDR_MASK_GPIO)) == ADDR_SPACE_GPIO) begin
      dev_sel_s1n_13 = 4'd2;

    end else if ((tl_s1n_13_us_h2d.a_address &
                  ~(ADDR_MASK_SPI_DEVICE)) == ADDR_SPACE_SPI_DEVICE) begin
      dev_sel_s1n_13 = 4'd3;

    end else if ((tl_s1n_13_us_h2d.a_address &
                  ~(ADDR_MASK_SPI_HOST0)) == ADDR_SPACE_SPI_HOST0) begin
      dev_sel_s1n_13 = 4'd4;

    end else if ((tl_s1n_13_us_h2d.a_address &
                  ~(ADDR_MASK_RV_TIMER)) == ADDR_SPACE_RV_TIMER) begin
      dev_sel_s1n_13 = 4'd5;

    end else if ((tl_s1n_13_us_h2d.a_address &
                  ~(ADDR_MASK_USBDEV)) == ADDR_SPACE_USBDEV) begin
      dev_sel_s1n_13 = 4'd6;

    end else if ((tl_s1n_13_us_h2d.a_address &
                  ~(ADDR_MASK_PWRMGR_AON)) == ADDR_SPACE_PWRMGR_AON) begin
      dev_sel_s1n_13 = 4'd7;

    end else if ((tl_s1n_13_us_h2d.a_address &
                  ~(ADDR_MASK_RSTMGR_AON)) == ADDR_SPACE_RSTMGR_AON) begin
      dev_sel_s1n_13 = 4'd8;

    end else if ((tl_s1n_13_us_h2d.a_address &
                  ~(ADDR_MASK_CLKMGR_AON)) == ADDR_SPACE_CLKMGR_AON) begin
      dev_sel_s1n_13 = 4'd9;

    end else if ((tl_s1n_13_us_h2d.a_address &
                  ~(ADDR_MASK_PINMUX_AON)) == ADDR_SPACE_PINMUX_AON) begin
      dev_sel_s1n_13 = 4'd10;

    end else if ((tl_s1n_13_us_h2d.a_address &
                  ~(ADDR_MASK_AST)) == ADDR_SPACE_AST) begin
      dev_sel_s1n_13 = 4'd11;
end
  end


  // Instantiation phase
  tlul_socket_1n #(
    .HReqDepth (4'h0),
    .HRspDepth (4'h0),
    .DReqDepth (48'h0),
    .DRspDepth (48'h0),
    .N         (12)
  ) u_s1n_13 (
    .clk_i        (clk_peri_i),
    .rst_ni       (rst_peri_ni),
    .tl_h_i       (tl_s1n_13_us_h2d),
    .tl_h_o       (tl_s1n_13_us_d2h),
    .tl_d_o       (tl_s1n_13_ds_h2d),
    .tl_d_i       (tl_s1n_13_ds_d2h),
    .dev_select_i (dev_sel_s1n_13)
  );
  tlul_fifo_async #(
    .ReqDepth        (1),
    .RspDepth        (1)
  ) u_asf_14 (
    .clk_h_i      (clk_peri_i),
    .rst_h_ni     (rst_peri_ni),
    .clk_d_i      (clk_spi_host0_i),
    .rst_d_ni     (rst_spi_host0_ni),
    .tl_h_i       (tl_asf_14_us_h2d),
    .tl_h_o       (tl_asf_14_us_d2h),
    .tl_d_o       (tl_asf_14_ds_h2d),
    .tl_d_i       (tl_asf_14_ds_d2h)
  );
  tlul_fifo_async #(
    .ReqDepth        (1),
    .RspDepth        (1)
  ) u_asf_15 (
    .clk_h_i      (clk_peri_i),
    .rst_h_ni     (rst_peri_ni),
    .clk_d_i      (clk_usb_i),
    .rst_d_ni     (rst_usb_ni),
    .tl_h_i       (tl_asf_15_us_h2d),
    .tl_h_o       (tl_asf_15_us_d2h),
    .tl_d_o       (tl_asf_15_ds_h2d),
    .tl_d_i       (tl_asf_15_ds_d2h)
  );

endmodule
